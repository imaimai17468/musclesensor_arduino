// library----------------------------------------------------------------------------------

#include <Servo.h>  // マイクロサーボモータ用のライブラリ

// -----------------------------------------------------------------------------------------
// define-----------------------------------------------------------------------------------

#define MAX_SIZE 2000 // 受け取るデータ数
#define PIN_SERVO 9   // D9：サーボモータ
#define PIN_METER 1   // A1：ポテンショメータ(角度)
#define PIN_SENSOR 0  // A0：筋電位センサ

//*******//
// DEBUG //
//*******// (使用しない場合はコメントアウト)
// #define METER_ON   // ポテンショメータを使用するか
// #define MOTERMODE  // センサ値をポテンショメータからの値にするか

// -----------------------------------------------------------------------------------------
// function(prototype)----------------------------------------------------------------------

void countdown(int t); // カウントダウン用関数
int culc_ave(void);       // グラフの下辺と上辺の平均を求める関数

// -----------------------------------------------------------------------------------------
// global-----------------------------------------------------------------------------------

int i = 0;                    // カウント変数
unsigned long t = 0;          // ループ毎の時間を保持する変数
unsigned long dis_t = 0;      // スタートからの時間を保持する変数
unsigned long delay_t = 0;    // サンプリング周期を調整するための遅延時間を保持する変数
int value = 0;                // センサの値を保持する変数
char moji;                    // シリアル通信の入力用変数
int angle = 0;                // シャフトの角度を保持する変数
double upper = 0, lower = 0;  // グラフの上辺と下辺の平均値を保持する関数

// Servoオブジェクトを作成
Servo myservo;

// -----------------------------------------------------------------------------------------
// setup------------------------------------------------------------------------------------

void setup() {
  Serial.begin(115200);

  // サーボモータにピンに割り当て0～180度のパルス幅をマイクロ秒で指定
  myservo.attach(PIN_SERVO);
  myservo.write(0); // サーボに角度を書き込む
  delay(500);       // シャフトがその位置に達するのを待つ
}

// -----------------------------------------------------------------------------------------
// main-------------------------------------------------------------------------------------

void loop() {
  // =======================================================================================
  // ポテンショメータを使うモード
  // サーボモータの動作確認用
  // =======================================================================================
  #ifdef METER_ON // (METER_ONが定義されていれば実行)
  // ポテンショメータから角度(0-180)を読み込む
  value = analogRead(PIN_METER);
  Serial.println(value);
  angle = map(value, 0, 1023, 0, 180);
  myservo.write(angle); // サーボに角度を書き込む
  delay(10);            // シャフトがその位置に達するのを待つ

  
  // =======================================================================================
  // 通常モード
  // 筋電位を読み取りサーボモータを制御する
  // =======================================================================================
  #else  
  if ((moji = Serial.read()) != -1) {
    // 制御に用いる値の測定
    // グラフの上辺と下辺の平均値を計測
    Serial.println("静止時の筋電位を測定します。");
    Serial.println("測定開始まで");
    countdown(5);
    lower = culc_ave();
    Serial.println("力を入れた時の筋電位を測定します。");
    Serial.println("測定開始まで");
    countdown(5);
    upper = culc_ave();

    // 結果を表示
    Serial.print("lower = ");
    Serial.println(lower);
    Serial.print("upper = ");
    Serial.println(upper);
    
    Serial.println("5秒後に制御モードへ移行します。");
    countdown(5);
    
    // 再び入力されるまで繰り返す
    while((moji = Serial.read()) == -1){
      // 動作内容============================================================================
      
      // センサ値をポテンショメータからの値にしたい場合(動作テストなど)
      // 動作テストとは：閾値や平均などのサーボモータを動かす要素が機能しているかのテスト
      #ifdef MOTERMODE
      value = analogRead(PIN_METER);
      
      // 通常動作で動かす場合(筋電位センサから受け取る)
      #else
      value = analogRead(PIN_SENSOR);

      #endif
      
      // ===================================================================================

      
      // サーボモータの制御====================================================================
      
      // 範囲外の値は範囲内に収める
      value = constrain(value, lower, upper);
      // グラフの下辺から上辺までを0°から180°に変換
      angle = map(value, lower, upper, 0, 180); 
      myservo.write(angle);

      // ===================================================================================

      Serial.println(value);
      delay(100);
    }
  }
  #endif
}

// -----------------------------------------------------------------------------------------
// function(prototype)----------------------------------------------------------------------

// カウントダウン用関数
void countdown(int t){
  for(i = t; i > 0; i--){
    Serial.println(i);
    delay(1000);
  }
}

// 筋電位の平均を求める関数
int culc_ave(void){
  double ave = 0;
  unsigned long start_t = micros();
  
  for(i = 0; i < MAX_SIZE; i++){
    t = micros();
    dis_t = t - start_t;
    
    #ifdef MOTERMODE
    value = analogRead(PIN_METER);
    #else
    value = analogRead(PIN_SENSOR);
    #endif

    ave += value;
    
    Serial.println(value);
    delay_t = micros() - t + (dis_t % 1000);
    delayMicroseconds(1000 - delay_t);
  }
  return ave / MAX_SIZE;
}

// -----------------------------------------------------------------------------------------
